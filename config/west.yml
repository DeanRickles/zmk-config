## config/west.yml
```yaml
manifest:
  remotes:
    - name: DeanRickles
      url-base: https://github.com/DeanRickles
  projects:
    - name: zmk-base
      remote: DeanRickles
      revision: main
      import: app/west.yml
    - name: zmk-helpers
      remote: DeanRickles
      revision: main
    - name: urchin-peripheral-animation
      remote: DeanRickles
      revision: main
  self:
    path: config
```

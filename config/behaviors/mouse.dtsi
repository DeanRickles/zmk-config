// Documentation : https://deploy-preview-778--zmk.netlify.app/docs/behaviors/mouse-emulation/
// Codes : https://github.com/zmkfirmware/zmk/blob/ee855f4d6736da4d696e74f7875d209c7c173a11/app/include/dt-bindings/zmk/mouse.h

#define ZMK_POINTING_DEFAULT_MOVE_VAL 1500 // Default 600

&mmv {
    acceleration-exponent=<2>;
    delay-ms=<30>;
    time-to-max-speed-ms = <200>;
};

&msc {
    acceleration-exponent=<1>;
    delay-ms=<30>;
    time-to-max-speed-ms = <200>;
};


// Move cursor
#define MOU_MV_L mmv MOVE_LEFT
#define MOU_MV_R mmv MOVE_RIGHT
#define MOU_MV_U mmv MOVE_UP
#define MOU_MV_D mmv MOVE_DOWN

//MOUSE - Buttons
#define MOU_CLK_L mkp LCLK
#define MOU_CLK_M mkp MCLK
#define MOU_CLK_R mkp RCLK

// Scroll wheel
#define SCRL_L msc SCRL_LEFT
#define SCRL_R msc SCRL_RIGHT
#define SCRL_U msc SCRL_UP
#define SCRL_D msc SCRL_DOWN

// Documentation : https://deploy-preview-778--zmk.netlify.app/docs/behaviors/mouse-emulation/
// Codes : https://github.com/zmkfirmware/zmk/blob/ee855f4d6736da4d696e74f7875d209c7c173a11/app/include/dt-bindings/zmk/mouse.h

#define ZMK_POINTING_DEFAULT_MOVE_VAL 2000 // Default 600 

// --------------------------------------------------
// Move cursor
// --------------------------------------------------
&mmv {
    acceleration-exponent=<2>;
    delay-ms=<10>;
    time-to-max-speed-ms = <150>;
};

// Mouse direction
#define mmv_lf mmv MOVE_LEFT
#define mmv_rg mmv MOVE_RIGHT
#define mmv_up mmv MOVE_UP
#define mmv_dn mmv MOVE_DOWN

// Mouse buttons
#define mkp_lf mkp LCLK
#define mkp_md mkp MCLK
#define mkp_rg mkp RCLK

// --------------------------------------------------
// Scroll wheel
// --------------------------------------------------
&msc {
    acceleration-exponent=<2>;
    delay-ms=<10>;
    time-to-max-speed-ms = <150>;
};

// scroll direction
#define mwh_lf msc SCRL_LEFT
#define mwh_rg msc SCRL_RIGHT
#define mwh_up msc SCRL_UP
#define mwh_dn msc SCRL_DOWN

// #define MWL SCRL_LEFT
// #define MWR SCRL_RIGHT
// #define MWU SCRL_UP
// #define MWD SCRL_DOWN

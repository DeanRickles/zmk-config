#include "./combos.dtsi"

// NOTE: Only thumb keys are different between 34 layouts
//       All other combos should be in ./combos.dtsi

/***********************
  THUMBS
***********************/

// Right thumbs
ZMK_COMBO(move_fnc, &mo FNC, RH0 RH1, COL)

// Left thumbs
ZMK_COMBO(move_sym, &mo SYM, LH0 LH1, COL)

// Inner thumbs
//ZMK_COMBO(qwerty_34, &tog QWE, LH0 RH0, COL)

// Outer thumbs
ZMK_COMBO(toggle_mov, &tog MOU, LH1 RH1, COL MOV)
